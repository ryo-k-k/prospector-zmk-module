## Kconfig
```kconfig
config PROSPECTOR_LAYER_ROLLER_ALL_CAPS
# Prospector ZMK Module Configuration

menu "Prospector Adapter Settings"

config PROSPECTOR_LAYER_ROLLER_ALL_CAPS
    bool "Convert layer names to all caps"
    default n

config PROSPECTOR_ROTATE_DISPLAY_180
    bool "Rotate the display 180 degrees"
    default n

config PROSPECTOR_USE_AMBIENT_LIGHT_SENSOR
    bool "Use ambient light sensor for auto brightness"
    default y

config PROSPECTOR_FIXED_BRIGHTNESS
    int "Fixed display brightness"
    default 50
    range 1 100
    depends on !PROSPECTOR_USE_AMBIENT_LIGHT_SENSOR

# Optional behavior hook flag
config ZMK_SENSOR_BEHAVIOR
    bool "Enable sensor-based behavior"
    default y

endmenu
```
